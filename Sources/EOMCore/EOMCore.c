// Generated by Tools/import_core.py; see Vendor/EdgeOMatic/LICENSE.

// Adapted from Maus-Tec Edge-o-Matic 3000, MIT; pinned revision in PROVENANCE.md.
#include "EOMCore.h"
#include <math.h>
#include <stdlib.h>
#include <string.h>

typedef enum { OD_STATE_IDLE, OD_STATE_SUSTAINED, OD_STATE_RHYTHMIC, OD_STATE_DETECTED } orgasm_detect_state_t;
typedef enum { OD_MODE_AUTO, OD_MODE_SUSTAINED, OD_MODE_RHYTHMIC } orgasm_detect_mode_t;
typedef enum { OC_STATE_RUNNING, OC_STATE_COOLDOWN, OC_STATE_RESUMING } oc_control_state_t;
typedef struct { unsigned long timestamp_ms; uint16_t amplitude; } peak_record_t;
#define PEAK_RING_SIZE 8
typedef struct { uint16_t buffer[64]; size_t window, index; uint32_t sum; uint16_t averaged; } running_average_t;

struct EOMEngine {
    EOMConfig config;
    uint64_t now_ms, last_ms;
    uint16_t raw_pressure;
    uint32_t events, random_seed;
    bool has_time;
    running_average_t average;
    struct {
        running_average_t *average;
        uint16_t last_value, pressure_value, peak_start, arousal;
        uint8_t update_flag;
    } arousal;
    struct {
        bool control_motor;
        float motor_speed;
        oc_control_state_t control_state;
        unsigned long cooldown_start_ms, resume_start_ms, cooldown_jitter_ms;
    } output;
    struct { float motor_speed; uint16_t arousal; } ramp;
    struct {
        orgasm_detect_state_t state;
        float baseline;
        bool baseline_initialized;
        unsigned long sustained_start_ms, last_above_threshold_ms;
        uint16_t prev_pressure[3];
        uint8_t prev_count;
        uint16_t peak_trough;
        peak_record_t peaks[8];
        uint8_t peak_write_idx, peak_count;
        bool last_was_rhythmic;
        unsigned long detected_at_ms;
        uint16_t last_interval_ms;
    } detection;
};

static uint16_t saturate(uint32_t value) { return value > UINT16_MAX ? UINT16_MAX : (uint16_t)value; }
static uint32_t next_random(EOMEngine *engine) {
    uint32_t x = engine->random_seed;
    x ^= x << 13; x ^= x >> 17; x ^= x << 5;
    return engine->random_seed = x;
}
static void running_average_add_value(running_average_t *average, uint16_t value) {
    average->sum -= average->buffer[average->index];
    average->buffer[average->index] = value;
    average->sum += value;
    average->index = (average->index + 1) % average->window;
    average->averaged = (uint16_t)(average->sum / average->window);
}
static uint16_t running_avergae_get_average(running_average_t *average) { return average->averaged; }

#define Config (engine->config)
#define arousal_state (engine->arousal)
#define output_state (engine->output)
#define state (engine->ramp)
// 'det.state' must remain a member name, so the ramp alias is expanded only locally below.
#undef state
#define det (engine->detection)
#define esp_timer_get_time() (engine->now_ms * 1000UL)
#define eom_hal_get_pressure_reading() (engine->raw_pressure)
#define ESP_LOGD(...) ((void)0)
#define ESP_LOGI(...) ((void)0)
#define ocTRUE 1
#define EVT_ORGASM_START EOM_DETECTED
#define EVT_ORGASM_DENIAL EOM_EDGE
#define EVT_ORGASM_PERMIT 0
#define event_manager_dispatch(event, unused, value) (engine->events |= (event))
#define update_check(variable, value) do { if ((variable) != (value)) { (variable) = (value); arousal_state.update_flag = 1; } } while (0)
#define _set_speed(speed) ((void)(speed))
#define calculate_increment(start, target, time_s) eom_ramp_increment(start, target, time_s, Config.update_frequency_hz)

static unsigned long _now_ms(EOMEngine *engine) {
    return (unsigned long)(esp_timer_get_time() / 1000UL);
}

static void _update_baseline(EOMEngine *engine, uint16_t pressure) {
    if (!det.baseline_initialized) {
        det.baseline = (float)pressure;
        det.baseline_initialized = true;
        return;
    }

    float tau = 5.0f; // seconds
    float alpha = 1.0f - expf(-1.0f / (tau * (float)Config.update_frequency_hz));

    // Only track baseline downward or during IDLE — don't chase sustained clenches upward.
    if (det.state == OD_STATE_IDLE) {
        det.baseline = det.baseline + alpha * ((float)pressure - det.baseline);
    } else {
        // During active detection, only let baseline drift downward (or very slowly up).
        if (pressure < det.baseline) {
            det.baseline = det.baseline + alpha * ((float)pressure - det.baseline);
        }
    }
}

static bool _detect_peak(EOMEngine *engine, uint16_t* out_amplitude) {
    if (det.prev_count < 3) return false;

    uint16_t a = det.prev_pressure[0];
    uint16_t b = det.prev_pressure[1]; // candidate peak
    uint16_t c = det.prev_pressure[2];

    if (b > a && b >= c) {
        // Local maximum found. Compute amplitude as peak - trough.
        uint16_t amplitude = (b > det.peak_trough) ? (b - det.peak_trough) : 0;

        if (amplitude >= (uint16_t)Config.od_peak_min_amplitude) {
            *out_amplitude = amplitude;
            det.peak_trough = c; // reset trough for next peak
            return true;
        }
    }

    // Track trough (running minimum since last peak)
    if (c < det.peak_trough) {
        det.peak_trough = c;
    }

    return false;
}

static void _record_peak(EOMEngine *engine, unsigned long timestamp_ms, uint16_t amplitude) {
    det.peaks[det.peak_write_idx].timestamp_ms = timestamp_ms;
    det.peaks[det.peak_write_idx].amplitude = amplitude;
    det.peak_write_idx = (det.peak_write_idx + 1) % PEAK_RING_SIZE;
    if (det.peak_count < 255) det.peak_count++;
}

static bool _check_rhythmic(EOMEngine *engine, int min_consecutive) {
    if (det.peak_count < (uint8_t)min_consecutive) return false;

    // Walk backward through the ring buffer checking intervals.
    int consecutive = 0;
    float sum_interval = 0;
    float sum_sq_interval = 0;

    int count = det.peak_count < PEAK_RING_SIZE ? det.peak_count : PEAK_RING_SIZE;
    if (count < min_consecutive) return false;

    for (int i = 0; i < count - 1; i++) {
        int idx_newer = (det.peak_write_idx - 1 - i + PEAK_RING_SIZE) % PEAK_RING_SIZE;
        int idx_older = (det.peak_write_idx - 2 - i + PEAK_RING_SIZE) % PEAK_RING_SIZE;

        unsigned long newer = det.peaks[idx_newer].timestamp_ms;
        unsigned long older = det.peaks[idx_older].timestamp_ms;

        if (newer <= older) break; // corrupted or wrapped data

        unsigned long interval = newer - older;
        det.last_interval_ms = (uint16_t)(interval > 0xFFFF ? 0xFFFF : interval);

        if (interval < (unsigned long)Config.od_rhythmic_interval_min_ms ||
            interval > (unsigned long)Config.od_rhythmic_interval_max_ms) {
            break; // out of expected cadence range
        }

        consecutive++;
        sum_interval += (float)interval;
        sum_sq_interval += (float)interval * (float)interval;
    }

    if (consecutive < min_consecutive - 1) return false; // need N peaks = N-1 intervals

    // Check interval variance
    float n = (float)consecutive;
    float mean = sum_interval / n;
    float variance = (sum_sq_interval / n) - (mean * mean);
    float std_dev = sqrtf(variance > 0 ? variance : 0);

    return std_dev <= (float)Config.od_rhythmic_interval_variance_ms;
}

static void _reset_to_idle(EOMEngine *engine) {
    det.state = OD_STATE_IDLE;
    det.peak_count = 0;
    det.peak_write_idx = 0;
    det.peak_trough = 0xFFFF;
    det.last_interval_ms = 0;
    det.sustained_start_ms = 0;
    det.last_above_threshold_ms = 0;
    memset(det.peaks, 0, sizeof(det.peaks));
}

static void orgasm_detection_init(EOMEngine *engine) {
    memset(&det, 0, sizeof(det));
    det.peak_trough = 0xFFFF;
    det.baseline_initialized = false;
    ESP_LOGI(TAG, "Orgasm detection initialized (mode=%d)", Config.od_mode);
}

static void orgasm_detection_tick(EOMEngine *engine, uint16_t pressure, uint16_t arousal) {
    unsigned long now = _now_ms(engine);

    // Always update baseline
    _update_baseline(engine, pressure);

    // Shift pressure history
    det.prev_pressure[0] = det.prev_pressure[1];
    det.prev_pressure[1] = det.prev_pressure[2];
    det.prev_pressure[2] = pressure;
    if (det.prev_count < 3) det.prev_count++;

    // Pressure relative to baseline
    long pressure_above_baseline = (long)pressure - (long)det.baseline;

    // Arousal gate: check if arousal is high enough to arm detection
    bool arousal_gate_met = true;
    if (Config.od_arousal_gate_percent > 0 && Config.sensitivity_threshold > 0) {
        int gate_level = (Config.sensitivity_threshold * Config.od_arousal_gate_percent) / 100;
        arousal_gate_met = (arousal >= (uint16_t)gate_level);
    }

    orgasm_detect_mode_t mode = (orgasm_detect_mode_t)Config.od_mode;

    switch (det.state) {
    case OD_STATE_IDLE: {
        if (pressure_above_baseline >= Config.od_sustained_threshold && arousal_gate_met) {
            det.state = OD_STATE_SUSTAINED;
            det.sustained_start_ms = now;
            det.last_above_threshold_ms = now;
            det.peak_count = 0;
            det.peak_write_idx = 0;
            det.peak_trough = pressure; // init trough to current value
            det.last_interval_ms = 0;
            memset(det.peaks, 0, sizeof(det.peaks));
            ESP_LOGD(TAG, "IDLE -> SUSTAINED (pressure=%d, baseline=%.0f)", pressure, det.baseline);
        }
        break;
    }

    case OD_STATE_SUSTAINED: {
        // Check for dropout: pressure fell below threshold for too long
        if (pressure_above_baseline >= Config.od_sustained_threshold) {
            det.last_above_threshold_ms = now;
        } else if ((now - det.last_above_threshold_ms) > (unsigned long)Config.od_sustained_dropout_ms) {
            ESP_LOGD(TAG, "SUSTAINED -> IDLE (dropout)");
            _reset_to_idle(engine);
            break;
        }

        // Detect peaks for rhythmic analysis
        uint16_t peak_amplitude = 0;
        if (_detect_peak(engine, &peak_amplitude)) {
            _record_peak(engine, now, peak_amplitude);
            ESP_LOGD(TAG, "Peak #%d detected (amplitude=%d)", det.peak_count, peak_amplitude);

            // Check for rhythmic pattern
            if (mode != OD_MODE_SUSTAINED) {
                if (_check_rhythmic(engine, 3)) {
                    det.state = OD_STATE_RHYTHMIC;
                    ESP_LOGD(TAG, "SUSTAINED -> RHYTHMIC");
                    break;
                }
            }
        }

        // Sustained-only fallback (AUTO or SUSTAINED mode)
        if (mode != OD_MODE_RHYTHMIC) {
            unsigned long sustained_ms = now - det.sustained_start_ms;
            if (sustained_ms >= (unsigned long)Config.od_sustained_fallback_ms) {
                // Check arousal gate is still met
                if (arousal_gate_met) {
                    det.state = OD_STATE_DETECTED;
                    det.last_was_rhythmic = false;
                    det.detected_at_ms = now;
                    ESP_LOGI(
                        TAG, "SUSTAINED -> DETECTED (sustained fallback, %lu ms)", sustained_ms
                    );
                    if (Config.od_detection_armed) {
                        event_manager_dispatch(EVT_ORGASM_START, NULL, 0);
                    }
                }
            }
        }

        // Clench arousal boost
        if (Config.od_clench_arousal_boost) {
            // The boost is applied by the caller (orgasm_control) reading our state.
            // We just stay in SUSTAINED — the caller checks our state each tick.
            // We should evaluate if it would make sense to pull this logic into here,
            // but this entire file was a mess to rewrite.
        }

        break;
    }

    case OD_STATE_RHYTHMIC: {
        // Continue detecting peaks
        uint16_t peak_amplitude = 0;
        if (_detect_peak(engine, &peak_amplitude)) {
            _record_peak(engine, now, peak_amplitude);
            ESP_LOGD(TAG, "Rhythmic peak #%d (amplitude=%d)", det.peak_count, peak_amplitude);
        }

        // Check if we've lost rhythmic pattern
        if (det.peak_count > 0) {
            int last_peak_idx = (det.peak_write_idx - 1 + PEAK_RING_SIZE) % PEAK_RING_SIZE;
            unsigned long since_last_peak = now - det.peaks[last_peak_idx].timestamp_ms;

            if (since_last_peak > (unsigned long)Config.od_rhythmic_timeout_ms) {
                // Lost rhythmic pattern — fall back to SUSTAINED, not IDLE
                det.state = OD_STATE_SUSTAINED;
                ESP_LOGD(TAG, "RHYTHMIC -> SUSTAINED (timeout %lu ms)", since_last_peak);
                break;
            }
        }

        // Check for confirmed rhythmic orgasm
        if (det.peak_count >= (uint8_t)Config.od_rhythmic_min_peaks) {
            if (_check_rhythmic(engine, Config.od_rhythmic_min_peaks)) {
                // Halved arousal gate for rhythmic detection — we're more confident
                bool rhythmic_gate_met = true;
                if (Config.od_arousal_gate_percent > 0 && Config.sensitivity_threshold > 0) {
                    int gate_level =
                        (Config.sensitivity_threshold * Config.od_arousal_gate_percent) / 200;
                    rhythmic_gate_met = (arousal >= (uint16_t)gate_level);
                }

                if (rhythmic_gate_met) {
                    det.state = OD_STATE_DETECTED;
                    det.last_was_rhythmic = true;
                    det.detected_at_ms = now;
                    ESP_LOGI(
                        TAG,
                        "RHYTHMIC -> DETECTED (%d peaks, last_interval=%d ms)",
                        det.peak_count,
                        det.last_interval_ms
                    );
                    if (Config.od_detection_armed) {
                        event_manager_dispatch(EVT_ORGASM_START, NULL, 0);
                    }
                }
            }
        }
        break;
    }

    case OD_STATE_DETECTED: {
        // Wait for pressure to return to baseline range for recovery_ms
        bool near_baseline = (pressure_above_baseline < Config.od_sustained_threshold / 2);

        if (near_baseline) {
            if ((now - det.detected_at_ms) >= (unsigned long)Config.od_recovery_ms) {
                ESP_LOGD(TAG, "DETECTED -> IDLE (recovered)");
                _reset_to_idle(engine);
            }
        } else {
            // Pressure still elevated — reset recovery timer
            det.detected_at_ms = now;
        }
        break;
    }

    default: _reset_to_idle(engine); break;
    }
}

static float ramp_start(EOMEngine *engine) {
    engine->ramp.motor_speed = Config.motor_min_speed;
    return Config.motor_min_speed;
}

static float ramp_increment(EOMEngine *engine) {
    float motor_increment = calculate_increment(
        Config.motor_min_speed, Config.motor_max_speed, Config.motor_ramp_time_s
    );

    if (engine->ramp.motor_speed < (Config.motor_max_speed - motor_increment)) {
        return engine->ramp.motor_speed + motor_increment;
    } else {
        return Config.motor_max_speed;
    }
}

static void ramp_tick(EOMEngine *engine, float motor_speed, uint16_t arousal) {
    engine->ramp.motor_speed = motor_speed;
    engine->ramp.arousal = arousal;
}

static float ramp_stop(EOMEngine *engine) {
    engine->ramp.motor_speed = 0.0f;
    return 0.0f;
}

static float ramp_on_edge(EOMEngine *engine) {
    return 0;
}

static void orgasm_control_updateArousal(EOMEngine *engine) {
    // Decay stale arousal value (tick-rate-independent):
    // arousal_decay_rate is the percentage retained per second (0-100).
    // Convert to per-tick factor: decay_factor = (rate/100) ^ (1/hz)
    //   = exp(ln(rate/100) / hz)
    float decay_rate = Config.arousal_decay_rate;
    if (decay_rate < 1) decay_rate = 1;
    if (decay_rate > 99) decay_rate = 99;
    float decay_factor = expf(logf(decay_rate / 100.0f) / (float)Config.update_frequency_hz);
    update_check(arousal_state.arousal, (uint16_t)(arousal_state.arousal * decay_factor));

    // Acquire new pressure and take average:
    arousal_state.pressure_value = eom_hal_get_pressure_reading();
    running_average_add_value(arousal_state.average, arousal_state.pressure_value);
    long p_avg = running_avergae_get_average(arousal_state.average);
    long p_check = Config.use_average_values ? p_avg : arousal_state.pressure_value;

    // Increment arousal
    if (p_check < arousal_state.last_value) {                      // falling edge of peak
        if (arousal_state.last_value > arousal_state.peak_start) { // first tick past peak?
            if (arousal_state.last_value - arousal_state.peak_start >=
                Config.sensitivity_threshold / 10) { // big peak

                update_check(
                    arousal_state.arousal,
                    saturate((uint32_t)arousal_state.arousal + (arousal_state.last_value - arousal_state.peak_start))
                );

                arousal_state.peak_start = p_check;
            }
        }

        if (p_check < arousal_state.peak_start) {
            // run this value down to a new minimum after a peak detected.
            arousal_state.peak_start = p_check;
        }
    }

    arousal_state.last_value = p_check;

}

static void orgasm_control_updateMotorSpeed(EOMEngine *engine) {
    if (!output_state.control_motor) return;

    ramp_tick(engine, output_state.motor_speed, arousal_state.arousal);

    unsigned long now_ms = esp_timer_get_time() / 1000UL;

    switch (output_state.control_state) {
    case OC_STATE_RUNNING: {
        // Motor is on, arousal detection active.
        float next_speed = ramp_increment(engine);
        update_check(output_state.motor_speed, next_speed);

        if (output_state.motor_speed > Config.motor_max_speed) {
            output_state.motor_speed = Config.motor_max_speed;
        }

        // Detect arousal threshold breach (guard: hold-off must have elapsed)
        if (arousal_state.arousal > Config.sensitivity_threshold && output_state.motor_speed > 0 &&
            (now_ms - output_state.resume_start_ms) >= (unsigned long)Config.arousal_holdoff_ms) {
            float edge_response = ramp_on_edge(engine);

            if (edge_response <= 0) {
                // Denial: transition RUNNING -> COOLDOWN
                output_state.control_state = OC_STATE_COOLDOWN;
                output_state.cooldown_start_ms = now_ms;
                output_state.cooldown_jitter_ms =
                    (Config.cooldown_random_ms > 0)
                        ? (unsigned long)(next_random(engine) % Config.cooldown_random_ms)
                        : 0;
                ramp_stop(engine);
                output_state.motor_speed = 0;
                arousal_state.update_flag = ocTRUE;
                event_manager_dispatch(EVT_ORGASM_DENIAL, NULL, 0);
                ESP_LOGD(
                    TAG, "RUNNING -> COOLDOWN (jitter: %lu ms)", output_state.cooldown_jitter_ms
                );
            } else {
                // Permit: stay running at the returned speed
                output_state.motor_speed = edge_response;
                arousal_state.update_flag = ocTRUE;
                event_manager_dispatch(EVT_ORGASM_PERMIT, NULL, 0);
            }
        }
        break;
    }

    case OC_STATE_COOLDOWN: {
        // Motor is off, waiting for cooldown to expire.
        output_state.motor_speed = 0;

        // Anti-twitch: reset cooldown timer on arousal spike
        if (arousal_state.arousal > Config.sensitivity_threshold) {
            output_state.cooldown_start_ms = now_ms;
        }

        // Check if cooldown period has elapsed
        unsigned long cooldown_total =
            (unsigned long)Config.cooldown_delay_ms + output_state.cooldown_jitter_ms;
        if ((now_ms - output_state.cooldown_start_ms) >= cooldown_total) {
            // Transition COOLDOWN -> RESUMING
            output_state.control_state = OC_STATE_RESUMING;
            output_state.resume_start_ms = now_ms;
            output_state.motor_speed = ramp_start(engine);
            ESP_LOGD(TAG, "COOLDOWN -> RESUMING");
        }
        break;
    }

    case OC_STATE_RESUMING: {
        // Motor restarting, hold-off timer active.
        float next_speed = ramp_increment(engine);
        update_check(output_state.motor_speed, next_speed);

        if (output_state.motor_speed > Config.motor_max_speed) {
            output_state.motor_speed = Config.motor_max_speed;
        }

        // Check if hold-off period has elapsed
        if ((now_ms - output_state.resume_start_ms) >= (unsigned long)Config.arousal_holdoff_ms) {
            output_state.control_state = OC_STATE_RUNNING;
            ESP_LOGD(TAG, "RESUMING -> RUNNING");
        }
        break;
    }

    default:
        // recover from corrupted state
        output_state.control_state = OC_STATE_RESUMING;
        output_state.resume_start_ms = now_ms;
        break;
    }

    // Control motor if we are not manually doing so.
    if (output_state.control_motor) {
        uint8_t speed = (uint8_t)output_state.motor_speed;
        _set_speed(speed);
    }
}

float eom_ramp_increment(uint8_t start, uint8_t target, float seconds, float frequency) {
    if (target < start || !isfinite(seconds) || !isfinite(frequency) || seconds <= 0 || frequency <= 0) return 0;
    return ((float)(target - start) / seconds) / frequency;
}
EOMConfig eom_default_config(void) {
    return (EOMConfig){
        .sensitivity_threshold=600, .arousal_decay_rate=60, .pressure_smoothing=5,
        .cooldown_delay_ms=1000, .cooldown_random_ms=1000, .arousal_holdoff_ms=1000,
        .motor_min_speed=10, .motor_max_speed=128, .motor_ramp_time_s=30, .update_frequency_hz=50,
        .od_sustained_threshold=200, .od_sustained_fallback_ms=5000, .od_sustained_dropout_ms=500,
        .od_peak_min_amplitude=40, .od_rhythmic_min_peaks=4, .od_rhythmic_interval_min_ms=500,
        .od_rhythmic_interval_max_ms=1200, .od_rhythmic_interval_variance_ms=200,
        .od_rhythmic_timeout_ms=1500, .od_arousal_gate_percent=70, .od_recovery_ms=3000,
        .od_clench_arousal_boost_amount=5, .od_detection_armed=true
    };
}
bool eom_valid_config(EOMConfig c) {
    return c.sensitivity_threshold >= 10 && c.sensitivity_threshold <= 65535 &&
        c.arousal_decay_rate >= 1 && c.arousal_decay_rate <= 99 &&
        c.pressure_smoothing >= 1 && c.pressure_smoothing <= 64 && c.update_frequency_hz == 50 &&
        c.cooldown_delay_ms >= 0 && c.cooldown_delay_ms <= 3600000 &&
        c.cooldown_random_ms >= 0 && c.cooldown_random_ms <= 3600000 &&
        c.arousal_holdoff_ms >= 0 && c.arousal_holdoff_ms <= 60000 &&
        c.motor_min_speed >= 1 && c.motor_max_speed >= c.motor_min_speed && c.motor_max_speed <= 255 &&
        c.motor_ramp_time_s >= 0 && c.motor_ramp_time_s <= 3600 &&
        c.od_mode >= 0 && c.od_mode <= 2 && c.od_sustained_threshold >= 1 && c.od_sustained_threshold <= 65535 &&
        c.od_sustained_fallback_ms >= 20 && c.od_sustained_fallback_ms <= 60000 &&
        c.od_sustained_dropout_ms >= 20 && c.od_sustained_dropout_ms <= 60000 &&
        c.od_peak_min_amplitude >= 1 && c.od_peak_min_amplitude <= 65535 &&
        c.od_rhythmic_min_peaks >= 3 && c.od_rhythmic_min_peaks <= 8 &&
        c.od_rhythmic_interval_min_ms >= 20 && c.od_rhythmic_interval_max_ms >= c.od_rhythmic_interval_min_ms &&
        c.od_rhythmic_interval_max_ms <= 60000 && c.od_rhythmic_interval_variance_ms >= 0 &&
        c.od_rhythmic_interval_variance_ms <= 60000 && c.od_rhythmic_timeout_ms >= 20 &&
        c.od_rhythmic_timeout_ms <= 60000 && c.od_arousal_gate_percent >= 0 && c.od_arousal_gate_percent <= 100 &&
        c.od_recovery_ms >= 20 && c.od_recovery_ms <= 60000 &&
        c.od_clench_arousal_boost_amount >= 0 && c.od_clench_arousal_boost_amount <= 50;
}
EOMEngine *eom_create(EOMConfig config, uint32_t seed) {
    if (!eom_valid_config(config)) return NULL;
    EOMEngine *engine = calloc(1, sizeof(*engine));
    if (!engine) return NULL;
    engine->config = config;
    engine->random_seed = seed ? seed : 1;
    engine->average.window = (size_t)config.pressure_smoothing;
    arousal_state.average = &engine->average;
    output_state.control_state = OC_STATE_RESUMING;
    orgasm_detection_init(engine);
    return engine;
}
void eom_destroy(EOMEngine *engine) { free(engine); }
bool eom_set_sensitivity(EOMEngine *engine, int32_t threshold) {
    if (!engine || threshold < 10 || threshold > 65535) return false;
    engine->config.sensitivity_threshold = threshold;
    return true;
}
void eom_set_armed(EOMEngine *engine, bool armed, uint64_t now_ms) {
    if (!engine) return;
    if (armed && !output_state.control_motor) {
        output_state.control_state = OC_STATE_RESUMING;
        output_state.resume_start_ms = now_ms;
        output_state.motor_speed = ramp_start(engine);
    } else if (!armed) {
        output_state.motor_speed = ramp_stop(engine);
    }
    output_state.control_motor = armed;
}
void eom_manual_edge(EOMEngine *engine, uint64_t now_ms) {
    if (!engine || !output_state.control_motor) return;
    output_state.control_state = OC_STATE_COOLDOWN;
    output_state.cooldown_start_ms = now_ms;
    output_state.cooldown_jitter_ms = Config.cooldown_random_ms > 0 ? next_random(engine) % Config.cooldown_random_ms : 0;
    output_state.motor_speed = ramp_stop(engine);
    engine->events |= EOM_MANUAL_EDGE;
}
void eom_hold_cooldown(EOMEngine *engine, uint64_t now_ms) {
    if (!engine || !output_state.control_motor) return;
    if (output_state.control_state != OC_STATE_COOLDOWN) {
        eom_manual_edge(engine, now_ms);
    } else {
        // Refresh the quiet period without rerolling jitter on every sample.
        output_state.cooldown_start_ms = now_ms;
        output_state.motor_speed = ramp_stop(engine);
    }
}
EOMSnapshot eom_step(EOMEngine *engine, uint16_t pressure, uint64_t now_ms) {
    if (!engine) return (EOMSnapshot){0};
    engine->events = 0;
    // Monotonic input is a trust boundary; do not let unsigned timers underflow.
    if (engine->has_time && now_ms < engine->last_ms) {
        eom_set_armed(engine, false, engine->last_ms);
        now_ms = engine->last_ms;
    }
    engine->has_time = true;
    engine->now_ms = engine->last_ms = now_ms;
    engine->raw_pressure = pressure;
    orgasm_control_updateArousal(engine);
    orgasm_control_updateMotorSpeed(engine);
    uint16_t p = Config.use_average_values ? engine->average.averaged : pressure;
    orgasm_detection_tick(engine, p, arousal_state.arousal);
    if (Config.od_clench_arousal_boost && (det.state == OD_STATE_SUSTAINED || det.state == OD_STATE_RHYTHMIC))
        arousal_state.arousal = saturate((uint32_t)arousal_state.arousal + Config.od_clench_arousal_boost_amount);
    uint16_t pending_peak = arousal_state.last_value > arousal_state.peak_start
        ? arousal_state.last_value - arousal_state.peak_start : 0;
    if (pending_peak < Config.sensitivity_threshold / 10) pending_peak = 0;
    return (EOMSnapshot){ .pressure=pressure, .average=engine->average.averaged,
        .arousal=arousal_state.arousal, .pending_peak=pending_peak, .peak_trough=arousal_state.peak_start,
        .control_phase=output_state.control_state, .detection_phase=det.state,
        .motor_speed=output_state.motor_speed, .events=engine->events,
        .wants_power=output_state.control_motor && output_state.motor_speed > 0,
        .rhythmic=det.last_was_rhythmic, .peak_count=det.peak_count, .last_interval_ms=det.last_interval_ms,
        .sustained_ms=det.state == OD_STATE_IDLE ? 0 : (uint32_t)(now_ms - det.sustained_start_ms) };
}
